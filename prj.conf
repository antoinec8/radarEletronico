## CMakeLists.txt
```
cmake_minimum_required(VERSION 3.20.0)

# Adiciona o módulo camera_service como EXTRA_MODULE (pasta interna)
set(ZEPHYR_EXTRA_MODULES "${CMAKE_CURRENT_SOURCE_DIR}/camera_service/camera_service")

find_package(Zephyr REQUIRED HINTS $ENV{ZEPHYR_BASE})
project(radar_eletronico)

# Adiciona diretório de includes
target_include_directories(app PRIVATE src)

# Adiciona todos os arquivos fonte
target_sources(app PRIVATE 
    src/main.c
    src/threads/sensor_thread.c
    src/threads/display_thread.c
    src/threads/camera_thread.c
)
```

## Kconfig
```
# Kconfig - Configurações do Radar Eletrônico
# Este arquivo define as opções configuráveis do sistema

mainmenu "Configuração do Radar Eletrônico"

config RADAR_SENSOR_DISTANCE_MM
	int "Distância entre sensores (mm)"
	default 1000
	help
	  Distância em milímetros entre os dois sensores magnéticos.
	  Usado para calcular a velocidade do veículo.

config RADAR_SPEED_LIMIT_LIGHT_KMH
	int "Limite de velocidade para veículos leves (km/h)"
	default 60
	help
	  Velocidade máxima permitida para veículos leves (2 eixos).
	  Acima deste valor, uma infração é registrada.

config RADAR_SPEED_LIMIT_HEAVY_KMH
	int "Limite de velocidade para veículos pesados (km/h)"
	default 40
	help
	  Velocidade máxima permitida para veículos pesados (3+ eixos).
	  Veículos pesados têm limite reduzido por segurança.

config RADAR_WARNING_THRESHOLD_PERCENT
	int "Percentual de alerta antes da infração (%)"
	default 90
	range 50 99
	help
	  Percentual do limite de velocidade que ativa o alerta amarelo.
	  Exemplo: 90% de 60 km/h = 54 km/h (amarelo), >= 60 km/h (vermelho).

config RADAR_CAMERA_FAILURE_RATE_PERCENT
	int "Taxa de falha da câmera simulada (%)"
	default 20
	range 0 100
	help
	  Probabilidade (0-100%) da câmera simular uma falha ao capturar
	  a placa. Usado para testar tratamento de erros.

source "Kconfig.zephyr"
```

## prj.conf
```kconfig
# Enable logging
CONFIG_LOG=y
CONFIG_LOG_MODE_IMMEDIATE=y
CONFIG_LOG_DEFAULT_LEVEL=3

# GPIO Support
CONFIG_GPIO=y

# Display Support (Display Dummy)
CONFIG_DISPLAY=y
CONFIG_DISPLAY_LOG_LEVEL_DBG=y

# ZBUS for inter-thread communication
CONFIG_ZBUS=y
CONFIG_ZBUS_RUNTIME_OBSERVERS=y
CONFIG_ZBUS_MSG_SUBSCRIBER=y

# Camera Service
CONFIG_CAMERA_SERVICE=y
CONFIG_QEMU_ICOUNT=n

# Thread priorities and stack sizes
CONFIG_MAIN_STACK_SIZE=2048
CONFIG_HEAP_MEM_POOL_SIZE=2048

# Enable assertions for debugging
CONFIG_ASSERT=y

# Pseudo-random number generator (for camera simulation)
CONFIG_TEST_RANDOM_GENERATOR=y
```

## mps2_an385.overlay
```dts
/*
 * Device Tree Overlay para mps2_an385
 * Configura GPIOs para sensores do radar
 */

/ {
	aliases {
		radar-sensor1 = &gpio0;
		radar-sensor2 = &gpio0;
	};
};

&gpio0 {
	status = "okay";
};
```

## src/main.c
```c
/**
 * @file main.c
 * @brief Thread principal do radar eletrônico
 * 
 * Orquestra todo o sistema:
 * - Recebe dados dos sensores
 * - Calcula velocidade
 * - Detecta infrações
 * - Aciona câmera
 * - Valida placas
 */

#include <zephyr/kernel.h>
#include <zephyr/logging/log.h>
#include <zephyr/zbus/zbus.h>
#include <string.h>
#include "types.h"
#include "utils/calculations.h"
#include "utils/plate_validator.h"

LOG_MODULE_REGISTER(main, LOG_LEVEL_INF);

/* Filas de mensagens */
K_MSGQ_DEFINE(sensor_msgq, sizeof(sensor_data_msg_t), 10, 4);
K_MSGQ_DEFINE(display_msgq, sizeof(display_data_msg_t), 10, 4);

/* Canais ZBUS */
ZBUS_CHAN_DEFINE(camera_trigger_chan,
                 camera_trigger_event_t,
                 NULL,
                 NULL,
                 ZBUS_OBSERVERS_EMPTY,
                 ZBUS_MSG_INIT(0));

ZBUS_CHAN_DEFINE(camera_result_chan,
                 camera_result_event_t,
                 NULL,
                 NULL,
                 ZBUS_OBSERVERS_EMPTY,
                 ZBUS_MSG_INIT(0));

/* Subscriber para resultado da câmera */
ZBUS_SUBSCRIBER_DEFINE(camera_result_sub, 4);

/**
 * @brief Processa dados do sensor e detecta infrações
 */
static void process_vehicle_detection(const sensor_data_msg_t *sensor_data)
{
    /* Calcula velocidade */
    uint32_t speed = calculate_speed_kmh(sensor_data->time_delta_ms, 
                                          CONFIG_RADAR_SENSOR_DISTANCE_MM);
    
    /* Determina limite aplicavel */
    uint32_t limit = get_speed_limit(sensor_data->vehicle_type,
                                      CONFIG_RADAR_SPEED_LIMIT_LIGHT_KMH,
                                      CONFIG_RADAR_SPEED_LIMIT_HEAVY_KMH);
    
    /* Determina status */
    speed_status_t status = determine_speed_status(speed, limit, 
                                                     CONFIG_RADAR_WARNING_THRESHOLD_PERCENT);
    
    /* Envia para display */
    display_data_msg_t display_msg = {
        .speed_kmh = speed,
        .vehicle_type = sensor_data->vehicle_type,
        .status = status,
        .speed_limit = limit,
        .plate = {0}  /* Inicializa vazio */
    };
    
    k_msgq_put(&display_msgq, &display_msg, K_NO_WAIT);
    
    /* Pequeno delay para display processar primeiro */
    k_msleep(50);
    
    /* Se infracao, aciona camera */
    if (status == SPEED_STATUS_VIOLATION) {
        LOG_WRN("*** INFRACAO DETECTADA! Acionando camera... ***");
        
        camera_trigger_event_t trigger = {
            .speed_kmh = speed,
            .vehicle_type = sensor_data->vehicle_type
        };
        
        /* Subscreve ao canal de resultado antes de publicar trigger */
        zbus_chan_add_obs(&camera_result_chan, &camera_result_sub, K_NO_WAIT);
        
        /* Publica evento de trigger */
        if (zbus_chan_pub(&camera_trigger_chan, &trigger, K_MSEC(100)) == 0) {
            /* Aguarda resultado da camera (com timeout) */
            const struct zbus_channel *chan;
            
            if (zbus_sub_wait(&camera_result_sub, &chan, K_SECONDS(2)) == 0) {
                camera_result_event_t result;
                
                if (zbus_chan_read(chan, &result, K_MSEC(100)) == 0) {
                    if (result.valid) {
                        /* Placa valida: atualiza display e registra */
                        strncpy(display_msg.plate, result.plate, sizeof(display_msg.plate) - 1);
                        k_msgq_put(&display_msgq, &display_msg, K_NO_WAIT);
                        k_msleep(50);
                        LOG_WRN(">>> INFRACAO REGISTRADA - Placa: %s <<<", result.plate);
                    } else if (strncmp(result.plate, "ERR", 3) == 0) {
                        /* Erro de camera: atualiza display com codigo de erro */
                        strncpy(display_msg.plate, result.plate, sizeof(display_msg.plate) - 1);
                        k_msgq_put(&display_msgq, &display_msg, K_NO_WAIT);
                        k_msleep(50);
                        LOG_ERR(">>> Falha na camera: %s <<<", result.plate);
                    } else {
                        /* Placa formato invalido: apenas loga, NAO atualiza display */
                        LOG_ERR(">>> INFRACAO NAO REGISTRADA - Placa formato invalido <<<");
                    }
                }
            } else {
                LOG_ERR("Timeout aguardando resultado da camera");
            }
        }
    }
}

int main(void)
{
    sensor_data_msg_t sensor_msg;
    
    LOG_INF("+========================================+");
    LOG_INF("|   RADAR ELETRONICO - INICIALIZANDO    |");
    LOG_INF("+========================================+");
    
    LOG_INF("Configuracoes:");
    LOG_INF("  - Distancia entre sensores: %d mm", CONFIG_RADAR_SENSOR_DISTANCE_MM);
    LOG_INF("  - Limite veiculos leves: %d km/h", CONFIG_RADAR_SPEED_LIMIT_LIGHT_KMH);
    LOG_INF("  - Limite veiculos pesados: %d km/h", CONFIG_RADAR_SPEED_LIMIT_HEAVY_KMH);
    LOG_INF("  - Limiar de alerta: %d%%", CONFIG_RADAR_WARNING_THRESHOLD_PERCENT);
    LOG_INF("  - Taxa de falha da camera: %d%%", CONFIG_RADAR_CAMERA_FAILURE_RATE_PERCENT);
    
    LOG_INF("\nSistema operacional - aguardando deteccoes...\n");
    
    /* Loop principal */
    while (1) {
        /* Aguarda dados dos sensores */
        if (k_msgq_get(&sensor_msgq, &sensor_msg, K_FOREVER) == 0) {
            process_vehicle_detection(&sensor_msg);
        }
    }

    return 0;
}
```

## src/types.h
```c
/**
 * @file types.h
 * @brief Definições de tipos e estruturas de dados do radar
 * 
 * Este arquivo centraliza todos os tipos, enums e structs usados
 * para comunicação entre threads e representação de dados do sistema.
 */

#ifndef RADAR_TYPES_H
#define RADAR_TYPES_H

#include <zephyr/kernel.h>
#include <stdint.h>

/**
 * @brief Tipos de veículos detectados
 */
typedef enum {
    VEHICLE_TYPE_LIGHT = 0,  /**< Veículo leve (2 eixos) */
    VEHICLE_TYPE_HEAVY = 1,  /**< Veículo pesado (3+ eixos) */
} vehicle_type_t;

/**
 * @brief Status de velocidade para exibição
 */
typedef enum {
    SPEED_STATUS_NORMAL = 0,   /**< Velocidade normal (verde) */
    SPEED_STATUS_WARNING = 1,  /**< Velocidade próxima ao limite (amarelo) */
    SPEED_STATUS_VIOLATION = 2 /**< Infração de velocidade (vermelho) */
} speed_status_t;

/**
 * @brief Estados da máquina de estados de detecção
 */
typedef enum {
    SENSOR_STATE_IDLE = 0,           /**< Aguardando passagem */
    SENSOR_STATE_COUNTING_AXLES = 1, /**< Contando eixos no sensor 1 */
    SENSOR_STATE_MEASURING_SPEED = 2,/**< Medindo tempo entre sensores */
    SENSOR_STATE_COMPLETE = 3        /**< Detecção completa */
} sensor_state_t;

/**
 * @brief Mensagem de dados do sensor para thread principal
 * 
 * Enviada pela thread de sensores via fila quando uma
 * detecção completa é realizada.
 */
typedef struct {
    uint32_t time_delta_ms;      /**< Tempo entre sensores (ms) */
    vehicle_type_t vehicle_type; /**< Tipo de veículo detectado */
    uint8_t axle_count;          /**< Número de eixos contados */
} sensor_data_msg_t;

/**
 * @brief Mensagem para atualização do display
 * 
 * Enviada pela thread principal para thread de display
 */
typedef struct {
    uint32_t speed_kmh;           /**< Velocidade calculada (km/h) */
    vehicle_type_t vehicle_type;  /**< Tipo de veículo */
    speed_status_t status;        /**< Status da velocidade */
    uint32_t speed_limit;         /**< Limite aplicável */
    char plate[8];                /**< Placa capturada (vazio se não for infração) */
} display_data_msg_t;

/**
 * @brief Evento ZBUS para trigger da câmera
 * 
 * Publicado quando há infração
 */
typedef struct {
    uint32_t speed_kmh;           /**< Velocidade da infração */
    vehicle_type_t vehicle_type;  /**< Tipo de veículo */
} camera_trigger_event_t;

/**
 * @brief Resultado da captura de placa
 * 
 * Publicado pela câmera simulada via ZBUS
 */
typedef struct {
    char plate[8];      /**< Placa Mercosul (7 chars + \0) */
    bool valid;         /**< Se a captura foi bem-sucedida */
    uint64_t timestamp; /**< Timestamp da captura */
} camera_result_event_t;

#endif /* RADAR_TYPES_H */
```
