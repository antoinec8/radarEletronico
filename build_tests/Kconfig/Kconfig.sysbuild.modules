## build_tests/Kconfig/Kconfig.sysbuild.modules
```kconfig
config ZEPHYR_ACPICA_MODULE
   bool
   default y
config ZEPHYR_CMSIS_MODULE
   bool
   default y
config ZEPHYR_CMSIS_DSP_MODULE
   bool
   default y
config ZEPHYR_CMSIS_NN_MODULE
   bool
   default y
config ZEPHYR_CMSIS_6_MODULE
   bool
   default y
config ZEPHYR_FATFS_MODULE
   bool
   default y
config ZEPHYR_ADI_MODULE
   bool
   default y
config ZEPHYR_HAL_AFBR_MODULE
   bool
   default y
config ZEPHYR_HAL_AMBIQ_MODULE
   bool
   default y
config ZEPHYR_ATMEL_MODULE
   bool
   default y
config ZEPHYR_HAL_BOUFFALOLAB_MODULE
   bool
   default y
config ZEPHYR_HAL_ESPRESSIF_MODULE
   bool
   default y
config ZEPHYR_HAL_ETHOS_U_MODULE
   bool
   default y
config ZEPHYR_HAL_GIGADEVICE_MODULE
   bool
   default y
config ZEPHYR_HAL_INFINEON_MODULE
   bool
   default y
config ZEPHYR_HAL_INTEL_MODULE
   bool
   default y
config ZEPHYR_MICROCHIP_MODULE
   bool
   default y
config ZEPHYR_HAL_NORDIC_MODULE
   bool
   default y
config ZEPHYR_NUVOTON_MODULE
   bool
   default y
config ZEPHYR_HAL_NXP_MODULE
   bool
   default y
config ZEPHYR_OPENISA_MODULE
   bool
   default y
config ZEPHYR_QUICKLOGIC_MODULE
   bool
   default y
config ZEPHYR_HAL_RENESAS_MODULE
   bool
   default y
config ZEPHYR_HAL_RPI_PICO_MODULE
   bool
   default y
config ZEPHYR_HAL_SIFLI_MODULE
   bool
   default y
config ZEPHYR_HAL_SILABS_MODULE
   bool
   default y
config ZEPHYR_HAL_ST_MODULE
   bool
   default y
config ZEPHYR_HAL_STM32_MODULE
   bool
   default y
config ZEPHYR_HAL_TDK_MODULE
   bool
   default y
config ZEPHYR_HAL_TELINK_MODULE
   bool
   default y
config ZEPHYR_TI_MODULE
   bool
   default y
config ZEPHYR_HAL_WCH_MODULE
   bool
   default y
config ZEPHYR_HAL_WURTHELEKTRONIK_MODULE
   bool
   default y
config ZEPHYR_XTENSA_MODULE
   bool
   default y
config ZEPHYR_HOSTAP_MODULE
   bool
   default y
config ZEPHYR_LIBLC3_MODULE
   bool
   default y
config ZEPHYR_LIBMCTP_MODULE
   bool
   default y
config ZEPHYR_LIBMETAL_MODULE
   bool
   default y
config ZEPHYR_LIBSBC_MODULE
   bool
   default y
config ZEPHYR_LITTLEFS_MODULE
   bool
   default y
config ZEPHYR_LORA_BASICS_MODEM_MODULE
   bool
   default y
```

## build_tests/Kconfig/boards/Kconfig.defconfig
```kconfig
# Load Zephyr board defconfig descriptions.
osource "C:/zephyrproject/zephyr/boards/arm/mps2/Kconfig.defconfig"
```

## build_tests/Kconfig/boards/Kconfig.mps2
```kconfig
# Load board Kconfig descriptions.
osource "C:/zephyrproject/zephyr/boards/arm/mps2/Kconfig.mps2"
```

## build_tests/Kconfig/boards/Kconfig.sysbuild
```kconfig
# Load Sysbuild board Kconfig descriptions.
osource "C:/zephyrproject/zephyr/boards/arm/mps2/Kconfig.sysbuild"
```

## tests/testcase.yaml
```yaml
common:
  tags:
    - radar
    - tests
  platform_allow: mps2/an385
tests:
  radar.unit_tests:
    tags: unit_test
```
